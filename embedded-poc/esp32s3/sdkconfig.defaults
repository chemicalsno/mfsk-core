## embedded-poc/esp32s3/sdkconfig.defaults
```kconfig
# Rust often needs a bit of an extra main task stack size compared to C (the default is 3K)
# You might have to increase this further if you allocate large stack variables in the main task
CONFIG_ESP_MAIN_TASK_STACK_SIZE=16384

# Increase a bit these stack sizes as they are also a bit too small by default
CONFIG_ESP_SYSTEM_EVENT_TASK_STACK_SIZE=4096
CONFIG_FREERTOS_IDLE_TASK_STACKSIZE=4096

# You might have to increase this further if you spawn your own Rust threads 
# that allocate large stack variables; or better yet - use 
# `std::thread::Builder::new().stack_size(XXX)` for spawning
CONFIG_PTHREAD_TASK_STACK_SIZE_DEFAULT=4096

# ── PSRAM (mfsk-core wide-band FFT cache needs > 1.5 MB on FT8) ────────
# Most ESP32-S3-WROOM-1 modules ship with 8 MB octal PSRAM. If your
# board only has internal SRAM, drop these and stick to the narrow-band
# / sniper-mode decoders (≤ 8192-point FFT, fits in SRAM).
CONFIG_SPIRAM=y
CONFIG_SPIRAM_MODE_OCT=y
CONFIG_SPIRAM_USE_MALLOC=y

# ── esp-dsp FFT — large twiddle table (up to 32k point) ────────────────
# Lets dsps_fft2r_init_fc32() handle our 4096-point sniper-mode and
# 8192-point WSPR aligned-decode FFTs out of the box.
CONFIG_DSP_TABLE_SIZE_4096_TO_32768=y
```

## embedded-poc/m5stack-core2/sdkconfig.defaults
```kconfig
# Rust often needs a bit of an extra main task stack size compared to C
# (the default is 3K). decode_block allocates a 372×4096 f32 spectrogram
# in the heap, not the stack — but the planner / cw / tov scratch in BP
# is heap too. 16K was sweep-margin-tight: a full 9-decode sweep tripped
# `A stack overflow in task main` right at `=== Sweep complete ===` even
# after replacing `std::thread::sleep` with direct `vTaskDelay`. 32K
# gives comfortable headroom.
CONFIG_ESP_MAIN_TASK_STACK_SIZE=32768

CONFIG_ESP_SYSTEM_EVENT_TASK_STACK_SIZE=4096
CONFIG_FREERTOS_IDLE_TASK_STACKSIZE=4096
CONFIG_PTHREAD_TASK_STACK_SIZE_DEFAULT=4096

# ── Disable unused subsystems to free internal SRAM ──────────────────
# decode_block wants the audio slot (360 KB) in internal SRAM for
# speed (40 MHz QUAD PSRAM is ~10× slower than internal). Default
# IDF config holds BT/WiFi/LWIP buffers in internal RAM, leaving us
# only ~270 KB free. Disable everything we don't use to free space.
CONFIG_BT_ENABLED=n
CONFIG_ESP_WIFI_ENABLED=n
CONFIG_LWIP_TCP_ENABLED=n
CONFIG_LWIP_UDP_ENABLED=n

# ── PSRAM (M5Stack Core2 ships with 8 MB QUAD PSRAM) ───────────────────
# decode_block needs ~6 MB peak heap (372 × 8192 × 4 = 12 MB
# spectrogram dropped before per-candidate DFT). Internal SRAM (520 KB)
# is too small. Original ESP32 (LX6) PSRAM is QUAD, not OCT — that
# differs from the S3 PoC's `CONFIG_SPIRAM_MODE_OCT`.
CONFIG_SPIRAM=y
CONFIG_SPIRAM_MODE_QUAD=y
CONFIG_SPIRAM_USE_MALLOC=y
# Honor PSRAM-allocated buffers from `Box<[T]>` / `Vec<T>` automatically.
# Lowered 16384 → 4096 for dual-core decode (`dual_core.rs`): both
# `pass2_split` halves hold ≤ 15 cs Box of 5 KB each in
# `refine_candidates_with`'s BinaryHeap simultaneously. With
# 16384 these 5 KB allocations stayed in internal DRAM (60 KB peak
# per half × 2 cores = 120 KB), exhausting the ~111 KB free
# contiguous DRAM and corrupting tlsf — Guru Meditation
# LoadProhibited at the Pass 2 → Stage 3 transition. At 4096 the
# cs Boxes route to PSRAM; they're only read once when packing
# RefinedCandidate so the bandwidth hit is negligible.
CONFIG_SPIRAM_MALLOC_ALWAYSINTERNAL=4096

# ── Task watchdog ────────────────────────────────────────────────────
# decode_block is a long-running compute kernel that doesn't yield —
# the default 5-second task watchdog will fire even on a normal run.
# Disable for the test bench; production builds (live RX) re-enable
# and yield via vTaskDelay between slot stages.
CONFIG_ESP_TASK_WDT_INIT=n

# ── esp-dsp FFT — extended twiddle table ─────────────────────────────
# decode_block uses NFFT_SPEC=8192 for the spectrogram FFT. The
# espressif/esp-dsp Kconfig knob is `DSP_MAX_FFT_SIZE` (NOT the
# fictitious `DSP_TABLE_SIZE_4096_TO_32768` name carried in the S3
# PoC's comment — that flag does nothing). Default is 4096; bump to
# 8192 so `dsps_fft2r_init_fc32(NULL, 8192)` returns ESP_OK.
CONFIG_DSP_MAX_FFT_SIZE_8192=y
```
